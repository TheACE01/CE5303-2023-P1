## poky/rpi2/conf/bblayers.conf
```bitbake
# POKY_BBLAYERS_CONF_VERSION is increased each time build/conf/bblayers.conf
# changes incompatibly
POKY_BBLAYERS_CONF_VERSION = "2"

BBPATH = "${TOPDIR}"
BBFILES ?= ""

BBLAYERS ?= " \
  /home/kfaceved/Desktop/Yocto/poky-dunfell-23.0.2/meta \
  /home/kfaceved/Desktop/Yocto/poky-dunfell-23.0.2/meta-poky \
  /home/kfaceved/Desktop/Yocto/poky-dunfell-23.0.2/meta-yocto-bsp \
  /home/kfaceved/Desktop/Yocto/poky-dunfell-23.0.2/meta-raspberrypi \
  /home/kfaceved/Desktop/Yocto/poky-dunfell-23.0.2/meta-webcam \
  /home/kfaceved/Desktop/Yocto/poky-dunfell-23.0.2/meta-openembedded/meta-oe \
  /home/kfaceved/Desktop/Yocto/poky-dunfell-23.0.2/meta-openembedded/meta-python \
  "
```
